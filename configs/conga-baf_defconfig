## configs/conga-baf_defconfig
```kconfig
BR2_x86_64=y
BR2_x86_opteron_sse3=y
BR2_CCACHE=y
BR2_PACKAGE_HOST_LINUX_HEADERS_CUSTOM_4_5=y
BR2_TOOLCHAIN_BUILDROOT_GLIBC=y
BR2_GCC_VERSION_4_8_X=y
BR2_TOOLCHAIN_BUILDROOT_CXX=y
BR2_TARGET_GENERIC_GETTY_PORT="tty1"
BR2_SYSTEM_DHCP="eth0"
BR2_ROOTFS_OVERLAY="board/congatec/conga-baf/rootfs-overlay"
BR2_LINUX_KERNEL=y
BR2_LINUX_KERNEL_CUSTOM_VERSION=y
BR2_LINUX_KERNEL_CUSTOM_VERSION_VALUE="4.5"
BR2_LINUX_KERNEL_USE_CUSTOM_CONFIG=y
BR2_LINUX_KERNEL_CUSTOM_CONFIG_FILE="board/congatec/conga-baf/linux-4.5.config"
BR2_PACKAGE_GLMARK2=y
BR2_PACKAGE_MESA3D=y
BR2_PACKAGE_MESA3D_GALLIUM_DRIVER_R600=y
BR2_PACKAGE_MESA3D_GALLIUM_DRIVER_SWRAST=y
BR2_PACKAGE_XORG7=y
BR2_PACKAGE_XSERVER_XORG_SERVER=y
BR2_PACKAGE_XAPP_XDPYINFO=y
BR2_PACKAGE_XAPP_XEV=y
BR2_PACKAGE_XAPP_XINIT=y
BR2_PACKAGE_XAPP_XINPUT=y
BR2_PACKAGE_XAPP_XINPUT_CALIBRATOR=y
BR2_PACKAGE_XAPP_XRANDR=y
BR2_PACKAGE_XAPP_XVINFO=y
BR2_PACKAGE_XDRIVER_XF86_INPUT_JOYSTICK=y
BR2_PACKAGE_XDRIVER_XF86_INPUT_KEYBOARD=y
BR2_PACKAGE_XDRIVER_XF86_INPUT_MOUSE=y
BR2_PACKAGE_XDRIVER_XF86_VIDEO_ATI=y
BR2_PACKAGE_XDRIVER_XF86_VIDEO_FBDEV=y
BR2_PACKAGE_XDRIVER_XF86_VIDEO_VESA=y
BR2_PACKAGE_LINUX_FIRMWARE=y
BR2_PACKAGE_LINUX_FIRMWARE_RADEON=y
BR2_PACKAGE_LINUX_FIRMWARE_RTL_81XX=y
BR2_PACKAGE_LINUX_FIRMWARE_RTL_8169=y
BR2_PACKAGE_LIBDRM_AMDGPU=y
BR2_PACKAGE_MTDEV=y
BR2_PACKAGE_LIBEVDEV=y
BR2_PACKAGE_KMOD=y
BR2_PACKAGE_UTIL_LINUX=y
BR2_PACKAGE_UTIL_LINUX_LIBBLKID=y
BR2_TARGET_ROOTFS_EXT2=y
BR2_TARGET_GRUB2=y
BR2_TARGET_GRUB2_X86_64_EFI=y
```

## package/amd-catalyst-driver/Config.in
```kconfig
comment "amd-catalyst-driver needs a glibc toolchain"
	depends on BR2_i386 || BR2_x86_64
	depends on !BR2_TOOLCHAIN_USES_GLIBC

config BR2_PACKAGE_AMD_CATALYST_DRIVER
	bool "amd-catalyst-driver"
	depends on BR2_i386 || BR2_x86_64
	depends on BR2_TOOLCHAIN_USES_GLIBC
	help
	  The binary-only driver blob for AMD cards.
	  This is the userland part only.

	  http://www.amd.com/
```

## package/psplash/Config.in
```kconfig
config BR2_PACKAGE_PSPLASH
	bool "psplash"
	depends on BR2_USE_WCHAR
	help
	  PSplash is a userspace graphical boot splash screen for
	  mainly embedded Linux devices supporting a 16bpp or 32bpp
	  framebuffer. It has few dependencies (just libc), supports
	  basic images and text and handles rotation. Its visual look
	  is configurable by basic source changes.

	  Also included is a 'client' command utility for sending
	  information to psplash such as boot progress information.

	  Start the drawing process with 'psplash -n&' as early as
	  possible. Note: psplash creates a FIFO in /tmp for
	  communication with psplash-write.

	  Usage:
	  * Set progress bar to 50 percent:
	    psplash-write "PROGRESS 50"

	  * Display message "foobar" above progress bar:
	    psplash-write "MSG foobar"

	  * Terminate psplash:
	    psplash-write "QUIT"

	  http://git.yoctoproject.org/cgit/cgit.cgi/psplash/

if BR2_PACKAGE_PSPLASH

	config BR2_PACKAGE_PSPLASH_IMAGE
		string "psplash image"
		help
			Use a personalized png image as boot splash.
			Let it empty if you want to keep the psplash default image.

	config BR2_PACKAGE_PSPLASH_FULL_SCREEN
		bool "use fullscreen mode"
		help
			Enable the psplash image in fullscreen mode.

	config BR2_PACKAGE_PSPLASH_NO_STARTUP_MSG
		bool "disable startup message"
		help
			Disable text banner output on startup.

	config BR2_PACKAGE_PSPLASH_NO_PROGRESS_BAR
		bool "disable progress bar"
		help
			Disable the management of the progress bar.

endif

comment "psplash needs a toolchain w/ wchar"
	depends on !BR2_USE_WCHAR
```
